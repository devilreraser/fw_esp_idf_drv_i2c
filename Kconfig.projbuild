## Kconfig.projbuild
```kconfig
menu "Component drv_i2c Configuration"

    config DRV_I2C_USE
        bool "Use drv_i2c component"
        default y

    choice DRV_I2C_0_PORT
        prompt "Select I2C Index 0 Port"
        default DRV_I2C_0_SELECT_I2C1
        depends on DRV_I2C_USE
        help
            Select I2C Index 0 Port.

        config DRV_I2C_0_SELECT_I2C1
            bool "I2C1"
            help
                I2C1 Interface.

        config DRV_I2C_0_SELECT_I2C2
            bool "I2C2"
            help
                I2C2 Interface.

        config DRV_I2C_0_SELECT_NONE
            bool "NONE"
            help
                No Interface.

    endchoice # DRV_I2C_0_PORT

    choice DRV_I2C_1_PORT
        prompt "Select I2C Index 1 Port"
        default DRV_I2C_1_SELECT_I2C2
        depends on DRV_I2C_USE
        help
            Select I2C Index 1 Port.

        config DRV_I2C_1_SELECT_I2C1
            bool "I2C1"
            help
                I2C1 Interface.

        config DRV_I2C_1_SELECT_I2C2
            bool "I2C2"
            help
                I2C2 Interface.

        config DRV_I2C_1_SELECT_NONE
            bool "NONE"
            help
                No Interface.

    endchoice # DRV_I2C_1_PORT

    config DRV_I2C_GPIO_MIN
        int "GPIO Minimum"
        default 0

    config DRV_I2C_GPIO_NONE
        int "GPIO Not Used"
        default -1

    config DRV_ETH_GPIO_OUT_MAX
        int "GPIO Maximum"
        default 33 if IDF_TARGET_ESP32
        default 46 if IDF_TARGET_ESP32S2
        default 19 if IDF_TARGET_ESP32C3
        default 48 if IDF_TARGET_ESP32S3

    config DRV_I2C_GPIO_IN_MAX
        int "GPIO Maximum"
        default 39 if IDF_TARGET_ESP32
        default 46 if IDF_TARGET_ESP32S2
        default 19 if IDF_TARGET_ESP32C3
        default 48 if IDF_TARGET_ESP32S3

    config DRV_I2C_0_SDA_GPIO
        int "I2C_0_SDA GPIO number"
        range DRV_I2C_GPIO_NONE DRV_ETH_GPIO_OUT_MAX
        depends on DRV_I2C_0_SELECT_I2C1 || DRV_I2C_0_SELECT_I2C2
        default -1
        help
            Set the GPIO number used by I2C_0_SDA.

    config DRV_I2C_0_SCL_GPIO
        int "I2C_0_SCL GPIO number"
        range DRV_I2C_GPIO_NONE DRV_ETH_GPIO_OUT_MAX
        depends on DRV_I2C_0_SELECT_I2C1 || DRV_I2C_0_SELECT_I2C2
        default -1
        help
            Set the GPIO number used by I2C_0_SCL.
    
    config DRV_I2C_0_FREQUENCY
        int "I2C_0 Frequency"
        depends on DRV_I2C_0_SELECT_I2C1 || DRV_I2C_0_SELECT_I2C2
        default 100000
        help
            Set I2C_0 Frequency.
    
    config DRV_I2C_1_FREQUENCY
        int "I2C_1 Frequency"
        depends on DRV_I2C_1_SELECT_I2C1 || DRV_I2C_1_SELECT_I2C2
        default 100000
        help
            Set I2C_1 Frequency.
    




    config DRV_I2C_1_SDA_GPIO
        int "I2C_1_SDA GPIO number"
        range DRV_I2C_GPIO_NONE DRV_ETH_GPIO_OUT_MAX
        depends on DRV_I2C_1_SELECT_I2C1 || DRV_I2C_1_SELECT_I2C2
        default -1
        help
            Set the GPIO number used by I2C_1_SDA.

    config DRV_I2C_1_SCL_GPIO
        int "I2C_1_SCL GPIO number"
        range DRV_I2C_GPIO_NONE DRV_ETH_GPIO_OUT_MAX
        depends on DRV_I2C_1_SELECT_I2C1 || DRV_I2C_1_SELECT_I2C2
        default -1
        help
            Set the GPIO number used by I2C_1_SCL.
    

endmenu
```
